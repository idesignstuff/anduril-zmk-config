## config/shields/anduril/Kconfig.shield
```kconfig
config SHIELD_ANDURIL_LEFT
    def_bool $(shields_list_contains,anduril_left)

config SHIELD_ANDURIL_RIGHT
    def_bool $(shields_list_contains,anduril_right)

config SHIELD_ANDURIL
    def_bool $(shields_list_contains,anduril)

    select NICE_NRF_I2C_0
    select NICE_NRF_SPI_0
```
